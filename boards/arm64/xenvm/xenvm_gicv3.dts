/*
 * Copyright (c) 2022 Arm Limited (or its affiliates). All rights reserved.
 * SPDX-License-Identifier: Apache-2.0
 */

#include "xenvm.dts"

&gic {
	reg = <0x00 0xf1000000 0x00 0x20000 0x00 0xf1060000 0x00 0x110000>;
};

&ram {
	reg = <0x00 0x60000000 0x00 DT_SIZE_M(256)>;
};
